## layers/th-container/conf/layer.conf
```bitbake
# We have a conf and classes directory, add to BBPATH
BBPATH =. "${LAYERDIR}:"

# We have a recipe-* directory, add to BBFILES
BBFILES += "${LAYERDIR}/recipes-*/*/*.bb \
            ${LAYERDIR}/recipes-*/*/*.bbappend"

BBFILE_COLLECTIONS += "th-container"
BBFILE_PATTERN_th-container = "^${LAYERDIR}/"
BBFILE_PRIORITY_th-container = "1000"

# Add scripts to PATH
#PATH .= ":${LAYERDIR}/scripts"

# Allow the developer to put pre-downloaded src into the downloads directory
# Also allow the user to have bare clones of repositories in the git directory
PREMIRRORS_append = "\
     git://.*/.* git://${LAYERDIR}/downloads/MIRRORNAME;protocol=file \n \
"

PNWHITELIST_LAYERS_remove = "th-container"
LAYERSERIES_COMPAT_th-container = "hardknott"
LAYERDEPENDS_th-container = "openembedded-layer"
```
